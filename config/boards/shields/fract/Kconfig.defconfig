## config/boards/shields/fract/Kconfig.defconfig
```kconfig
# Copyright (c) 2024 The ZMK Contributors
# SPDX-License-Identifier: MIT

if SHIELD_FRACT

config ZMK_KEYBOARD_NAME
    default "Fract"

endif
```

## config/boards/shields/fract/Kconfig.shield
```kconfig
# Copyright (c) 2024 The ZMK Contributors
# SPDX-License-Identifier: MIT

config SHIELD_FRACT
    def_bool $(shields_list_contains,fract)
```

## config/boards/shields/morizon/Kconfig.defconfig
```kconfig
# Copyright (c) 2022 The ZMK Contributors
# SPDX-License-Identifier: MIT

if SHIELD_MORIZON

config ZMK_KEYBOARD_NAME
    default "Morizon"

config ZMK_PM_SOFT_OFF
    default y

endif
```

## config/boards/shields/morizon/Kconfig.shield
```kconfig
# Copyright (c) 2022 The ZMK Contributors
# SPDX-License-Identifier: MIT

config SHIELD_MORIZON
    def_bool $(shields_list_contains,morizon)
```

## config/boards/shields/tackle/Kconfig.defconfig
```kconfig
# Copyright (c) 2024 The ZMK Contributors
# SPDX-License-Identifier: MIT

if SHIELD_TACKLE

config ZMK_KEYBOARD_NAME
    default "Tackle"

endif
```

## config/boards/shields/tackle/Kconfig.shield
```kconfig
# Copyright (c) 2024 The ZMK Contributors
# SPDX-License-Identifier: MIT

config SHIELD_TACKLE
    def_bool $(shields_list_contains,tackle)
```
